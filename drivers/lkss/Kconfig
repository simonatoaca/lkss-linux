## drivers/lkss/Kconfig
```kconfig
# SPDX-License-Identifier: GPL-2.0-only

menuconfig LKSS_DRIVERS
	bool "Linux Kernel Summer School drivers"
	default n
	help
	  Enable support for Linux Kernel Summer School drivers.

if LKSS_DRIVERS

config LKSS_DRIVERS_LAB2
	tristate "Linux Kernel Summer School lab 2 drivers"
	default n
	help
	  Enable support for lab 2 drivers.

source "drivers/lkss/lab2/Kconfig"

endif # LKSS_DRIVERS
```

## drivers/lkss/lab2/Kconfig
```kconfig
# SPDX-License-Identifier: GPL-2.0-only

if LKSS_DRIVERS_LAB2

config LKSS_DRIVERS_LAB2_EX3
	tristate "Lab2 Ex3 - Character device LED driver using gpiod"
	default n
	help
	  Compile Lab2 Ex3: Character device LED driver using gpiod

config LKSS_DRIVERS_LAB2_EX3_IOCTL
        bool "Enable ioctl call for ex3 driver"
        default n
        depends on LKSS_DRIVERS_LAB2_EX3
        help
          Compile with support for ioctl() call

config LKSS_DRIVERS_LAB2_EX4
	tristate "Lab2 Ex4 - Using buttons with irqs for LED ctrl"
	default n
	help
	  Compile Lab2 Ex4: Using buttons with irqs for LED ctrl

endif # LKSS_DRIVERS_LAB2
```
